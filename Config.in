## Config.in
```kconfig
source "$BR2_EXTERNAL_ZYNQ_NEGGLES_PATH/board/ebaz4205/Config.in"
source "$BR2_EXTERNAL_ZYNQ_NEGGLES_PATH/board/s9miner/Config.in"

#config ZYNQ_NEGGLES_BOOT_MODE
```

## configs/zynq_ebaz4205_defconfig
```kconfig
BR2_arm=y
BR2_cortex_a9=y
BR2_ARM_ENABLE_NEON=y
BR2_ARM_ENABLE_VFP=y
BR2_TARGET_GENERIC_GETTY_PORT="ttyPS0"
BR2_ROOTFS_OVERLAY="$(BR2_EXTERNAL_ZYNQ_NEGGLES_PATH)/board/ebaz4205/rootfs"
BR2_LINUX_KERNEL=y
BR2_LINUX_KERNEL_VERSION="5.15.6"
BR2_LINUX_KERNEL_CUSTOM_VERSION=y
BR2_LINUX_KERNEL_CUSTOM_VERSION_VALUE="5.15.6"
BR2_PACKAGE_HOST_LINUX_HEADERS_CUSTOM_5_9=y
BR2_LINUX_KERNEL_UIMAGE=y
BR2_LINUX_KERNEL_UIMAGE_LOADADDR="0x8000"
BR2_LINUX_KERNEL_DTS_SUPPORT=y
BR2_LINUX_KERNEL_USE_CUSTOM_DTS=y
BR2_LINUX_KERNEL_CUSTOM_DTS_PATH="$(BR2_EXTERNAL_ZYNQ_NEGGLES_PATH)/board/ebaz4205/dts/zynq-ebaz4205.dts"
BR2_LINUX_KERNEL_USE_CUSTOM_CONFIG=y
BR2_LINUX_KERNEL_CUSTOM_CONFIG_FILE="$(BR2_EXTERNAL_ZYNQ_NEGGLES_PATH)/board/ebaz4205/linux-5.15.y.config"
BR2_TARGET_ROOTFS_CPIO=y
BR2_TARGET_ROOTFS_CPIO_GZIP=y
BR2_TARGET_ROOTFS_CPIO_UIMAGE=y
BR2_TARGET_UBOOT=y
BR2_TARGET_UBOOT_BUILD_SYSTEM_KCONFIG=y
BR2_TARGET_UBOOT_CUSTOM_CONFIG_FILE="$(BR2_EXTERNAL_ZYNQ_NEGGLES_PATH)/board/ebaz4205/u-boot.config"
BR2_TARGET_UBOOT_CUSTOM_DTS_PATH="$(BR2_EXTERNAL_ZYNQ_NEGGLES_PATH)/board/ebaz4205/dts/zynq-ebaz4205.dts"
BR2_TARGET_UBOOT_CUSTOM_GIT=y
BR2_TARGET_UBOOT_CUSTOM_REPO_URL="https://github.com/Xilinx/u-boot-xlnx.git"
BR2_TARGET_UBOOT_CUSTOM_REPO_VERSION="xilinx-v2021.2"
BR2_TARGET_UBOOT_BOARD_DEFCONFIG="zynq_ebaz4205"
BR2_TARGET_UBOOT_NEEDS_DTC=y
BR2_TARGET_UBOOT_NEEDS_OPENSSL=y
BR2_TARGET_UBOOT_FORMAT_IMG=y
BR2_TARGET_UBOOT_SPL=y
BR2_TARGET_UBOOT_SPL_NAME="spl/boot.bin"
BR2_PACKAGE_HOST_DOSFSTOOLS=y
BR2_PACKAGE_HOST_GENIMAGE=y
BR2_PACKAGE_HOST_MTOOLS=y
BR2_TARGET_GENERIC_HOSTNAME="zynq7k"
BR2_TARGET_GENERIC_ISSUE="welcome to zynq"
BR2_TARGET_GENERIC_ROOT_PASSWD="root"
BR2_PACKAGE_LINUX_TOOLS_GPIO=y
BR2_PACKAGE_MTD=y
BR2_PACKAGE_MTD_MKFSUBIFS=y
BR2_PACKAGE_STRACE=y
BR2_PACKAGE_COREUTILS=y
BR2_PACKAGE_DROPBEAR=y
BR2_PACKAGE_PHYTOOL=y
BR2_PACKAGE_PICOCOM=y
BR2_PACKAGE_ETHTOOL=y
```
